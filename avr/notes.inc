
; Generated by notes_gen.py

; Note IDs
.equ NOTE_DO = 0
.equ NOTE_DOS = 1
.equ NOTE_RE = 2
.equ NOTE_RES = 3
.equ NOTE_MI = 4
.equ NOTE_FA = 5
.equ NOTE_FAS = 6
.equ NOTE_SO = 7
.equ NOTE_SOS = 8
.equ NOTE_LA = 9
.equ NOTE_LAS = 10
.equ NOTE_SI = 11
.equ NOTE_DOH = 12
.equ NOTE_DOHS = 13
.equ NOTE_REH = 14
.equ NOTE_REHS = 15
.equ NOTE_MIH = 16
.equ NOTE_FAH = 17
.equ NOTE_FAHS = 18
.equ NOTE_SOH = 19
.equ NOTE_SOHS = 20
.equ NOTE_LAH = 21
.equ NOTE_LAHS = 22
.equ NOTE_SIH = 23
.equ NOTE_SILENCE = 24

; Beat Ids
.equ NOTE_Q = 1 << 5
.equ NOTE_H = 2 << 5
.equ NOTE_W = 4 << 5

.cseg

NOTES: .db 238, 224, 212, 200, 189, 178, 168, 158, 149, 141, 133, 126, 118, 112, 105, 99, 94, 88, 83, 79, 74, 70, 66, 62

